#include "melt.h"

/**
 *     Инициализация SPI контроллера
 *          Требуемые данные:
 *
 * Пины:   GP_PP    -> LCD_RES
 *         SPI_CLK  -> LCD_SCL
 *         GP_PP    -> LCD_A0
 *         SPI_MOSI -> LCD_SI
 *         GP_PP    -> LCD_CSI
 *
 * Режим SPI: 1   -   1
 *            ---- ----
 *            CPOL CPHA
 *            ---- ----
 *            Пол. Фаза
 *
 * Выбор слейва за контроллером
 * Направление работы - мастер
 **/

#include <alloca.h>
#include <stdarg.h>
#include <stddef.h>
#include <stdio.h>
#include <stdlib.h>

[[gnu::weak]] extern void melt_hardware(void) {
    /**
     * GP_PP:      MELT_RES
     * SPI_CLK:    MELT_SCL
     * GP_PP:      MELT_A0
     * SPI_MOSI:   MELT_SI
     * GP_PP:      MELT_CSI
     *
     * Enable SPI
     **/
}

[[gnu::weak]] extern void melt_send([[maybe_unused]] uint8_t data, [[maybe_unused]] uint8_t a0) {
    /**
     * MELT_A0(a0);
     *
     * while (!(SPI_TX_IS_EMPTY));
     *
     * SPI_DATA_REGISTER = data;
     **/
}

[[gnu::weak]] extern void melt_init(void) {
    /**
     * static const uint8_t cmd[] = {0x2F, 0x27, 0x89, 0x00, 0x81, 0x30, 0x40, 0xA6, 0xC8, 0xA0, 0xAF};
     * enum { TIMEOUT = USHRT_MAX };
     * melt_hardware();
     *
     * MELT_RES(0);
     * MELT_CSI(1);
     * for (size_t i = 0; i < TIMEOUT; i++);
     * MELT_RES(1);
     * MELT_CSI(0);
     * for (size_t i = 0; i < sizeof_array(cmd); i++)
     *     melt_send_command(cmd[i]);
     * melt_pour_all(MODE_CLEAR);
     **/
}

extern void melt_send_data(uint8_t data) { melt_send(data, 1); }

extern void melt_send_command(uint8_t cmd) { melt_send(cmd, 0); }

extern void melt_address(uint8_t a) {
    const uint8_t cmd[] = {0x10 | (a >> 4), 0x0F & a};
    for (size_t i = 0; i < sizeof_array(cmd); i++) /*  */
        melt_send_command(cmd[i]);
}

extern void melt_pour_all(mode_t mode) {
    for (uint8_t str = 0; str < (MELT_HEIGHT / 8); str++) {
        const uint8_t cmd[] = {0xB0 + str, 0x10, 0x00};
        for (size_t i = 0; i < sizeof_array(cmd); i++) /*  */
            melt_send_command(cmd[i]);
        for (uint8_t col = 0; col < MELT_WIDTH; col++) {
            switch (mode) {
            case MODE_DRAW:
                screen[str][col] |= UCHAR_MAX;
                break;
            case MODE_CLEAR:
                screen[str][col] = 0x00;
                break;
            case MODE_INVERT:
                screen[str][col] ^= UCHAR_MAX;
                break;
            }
            melt_send_data(screen[str][col]);
        }
    }
}

extern void melt_pour_area(mode_t mode, uint8_t str, uint8_t col, uint8_t height, uint8_t width) {
    for (uint8_t add = 0; (add < height) && (str + add < MELT_HEIGHT); add++)
        melt_draw_line_horizontal(mode, str + add, col, width);
}

extern void melt_pour_bitmap(mode_t mode, uint8_t str, uint8_t col, uint8_t *image, uint8_t height, uint8_t width) {
    if (str >= MELT_HEIGHT && col >= MELT_WIDTH)
        return;

    for (uint8_t x = 0; (x < width) && (col + x < MELT_WIDTH); x++) {
        union qword full = {0};
        uint8_t local = col + x;
        for (uint8_t y = 0; (y < height) && ((y * 8) < MELT_HEIGHT); y++) {
            uint8_t shift = str + (y * 8);
            if (shift < 32)
                full.dword[0] |= image[(y * width) + x] << shift;
            if (shift > 24)
                full.dword[1] |=
                    (shift > 32) ? image[(y * width) + x] << (shift - 32) : image[(y * width) + x] >> (32 - shift);
        }
        for (uint8_t y = 0; y < (MELT_HEIGHT / 8); y++) {
            const uint8_t cmd[] = {0xB0 + y, 0x10 + (local / 16), local % 16};
            for (size_t i = 0; i < sizeof_array(cmd); i++) /*  */
                melt_send_command(cmd[i]);
            switch (mode) {
            case MODE_DRAW:
                screen[y][local] |= full.byte[y];
                break;
            case MODE_CLEAR:
                screen[y][local] &= ~full.byte[y];
                break;
            case MODE_INVERT:
                screen[y][local] ^= full.byte[y];
                break;
            }
            melt_send_data(screen[y][local]);
        }
    }
}

extern void melt_draw_pixel(mode_t mode, uint8_t str, uint8_t col) {
    if (str >= MELT_HEIGHT && col >= MELT_WIDTH)
        return;

    const uint8_t l = str / 8, s = str % 8, cmd[] = {0xB0 + l, 0x10 + (col / 16), col % 16};
    for (size_t i = 0; i < sizeof_array(cmd); i++) /*  */
        melt_send_command(cmd[i]);
    switch (mode) {
    case MODE_DRAW:
        screen[l][col] |= 1 << s;
        break;
    case MODE_CLEAR:
        screen[l][col] &= ~(1 << s);
        break;
    case MODE_INVERT:
        screen[l][col] ^= 1 << s;
        break;
    }
    melt_send_data(screen[l][col]);
}

extern void melt_draw_line_horizontal(mode_t mode, uint8_t str, uint8_t col, uint8_t len) {
    for (uint8_t add = 0; (add < len) && (col + add < MELT_WIDTH); add++) /*  */
        melt_draw_pixel(mode, str, col + add);
}

extern void melt_draw_line_vertical(mode_t mode, uint8_t str, uint8_t col, uint8_t len) {
    for (uint8_t add = 0; (add < len) && (str + add < MELT_HEIGHT); add++) /*  */
        melt_draw_pixel(mode, str + add, col);
}

extern void melt_draw_line_arbitrary(mode_t mode, uint8_t str_from, uint8_t col_from, uint8_t str_to, uint8_t col_to) {
    int8_t dx = col_to - col_from, dy = str_to - str_from, mx = (abs(dx) > abs(dy)) ? dx : dy;
    int32_t tang = (abs(dx) > abs(dy)) ? (dy << 10) / dx : (dx << 10) / dy;

    for (int8_t it = 0; it != mx; (mx > 0) ? it++ : it--) {
        uint8_t first_add = (abs(dx) > abs(dy)) ? str_from + ((it * tang) >> 10) : str_from + it,
                second_add = (abs(dx) > abs(dy)) ? col_from + it : col_from + ((it * tang) >> 10);
        melt_draw_pixel(mode, first_add, second_add);
    }
}

extern void melt_draw_rectangle(mode_t mode, uint8_t str, uint8_t col, uint8_t height, uint8_t width) {
    melt_draw_line_horizontal(mode, str, col, width);
    melt_draw_line_vertical(mode, str + 1, col + width - 1, height - 1);
    melt_draw_line_vertical(mode, str + 1, col, height - 1);
    melt_draw_line_horizontal(mode, str + height - 1, col + 1, width - 2);
}

extern void melt_draw_circle(mode_t mode, uint8_t str, uint8_t col, uint8_t rad) {
    for (int8_t x = 0, y = rad, magic = 3 - 2 * rad;;) {
        melt_draw_pixel(mode, y + str, x + col);
        melt_draw_pixel(mode, -y + str, x + col);
        melt_draw_pixel(mode, -y + str, -x + col);
        melt_draw_pixel(mode, y + str, -x + col);
        melt_draw_pixel(mode, x + str, y + col);
        melt_draw_pixel(mode, -x + str, y + col);
        melt_draw_pixel(mode, -x + str, -y + col);
        melt_draw_pixel(mode, x + str, -y + col);

        if (x >= y)
            break;

        if (magic <= 0)
            magic += 4 * x + 6;
        else
            magic += 4 * (x - y) + 10, y--;

        x++;
    }
}

/* Author: http://code.google.com/p/convert-utf8-to-cp1251/ */

typedef struct letter {
    uint8_t win1251;
    wchar_t utf;
} letter_t;

static const letter_t g_letters[] = {
    {0x82, 0x201A}, {0x83, 0x0453}, {0x84, 0x201E}, {0x85, 0x2026}, {0x86, 0x2020}, {0x87, 0x2021}, {0x88, 0x20AC},
    {0x89, 0x2030}, {0x8A, 0x0409}, {0x8B, 0x2039}, {0x8C, 0x040A}, {0x8D, 0x040C}, {0x8E, 0x040B}, {0x8F, 0x040F},
    {0x90, 0x0452}, {0x91, 0x2018}, {0x92, 0x2019}, {0x93, 0x201C}, {0x94, 0x201D}, {0x95, 0x2022}, {0x96, 0x2013},
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    {0xBB, 0x00BB}, {0xBC, 0x0458}, {0xBD, 0x0405}, {0xBE, 0x0455}, {0xBF, 0x0457}};

static ssize_t utf8_to_win1251(uint8_t *data, size_t size) {
    ssize_t j = 0;

    if (data == NULL || size == 0)
        return -1;

    for (size_t i = 0; i < size && data[i] != '\0'; i++) {
        uint8_t prefix = data[i];
        if ((prefix & 0x80) == 0) {
            data[j] = prefix;
            j++;
        } else if ((~prefix) & 0x20 && i + 1 < size) {
            wchar_t first5bit = (wchar_t)(prefix & 0x1F) << 6, sec6bit = data[i + 1] & 0x3F,
                    unicode_char = first5bit + sec6bit;
            if (unicode_char >= 0x410 && unicode_char <= 0x44F)
                data[j] = (uint8_t)(unicode_char - 0x350);
            else if (unicode_char >= 0x80 && unicode_char <= 0xFF)
                data[j] = (uint8_t)(unicode_char);
            else if (unicode_char >= 0x402 && unicode_char <= 0x403)
                data[j] = (uint8_t)(unicode_char - 0x382);
            else {
                size_t count = sizeof(g_letters) / sizeof(letter_t);
                for (size_t k = 0; k < count; k++) {
                    if (unicode_char == g_letters[k].utf) {
                        data[j] = g_letters[k].win1251;
                        goto next;
                    }
                }
                return -1;
            }
        next:
            i++, j++;
        } else
            return -1;
    }
    data[j++] = '\0';

    return j;
}

[[gnu::__noinline__]] extern void melt_printf(mode_t mode, uint8_t str, uint8_t col, const uint8_t *fmt, ...) {
    va_list args;
    volatile ssize_t size;
    uint8_t *out;

    if (str >= MELT_HEIGHT || fmt == NULL)
        return;

    va_start(args, fmt);
    size = vsnprintf(NULL, 0, (const char *)fmt, args) + sizeof_array("");
    va_end(args);

    out = (uint8_t *)alloca(size * sizeof(uint8_t));
    if (out == NULL)
        return;

    va_start(args, fmt);
    vsnprintf((char *)out, size, (const char *)fmt, args);
    va_end(args);

    size = utf8_to_win1251(out, size);
    if (size < 0)
        return;

    for (ssize_t i = 0; i < size && out[i] != '\0'; i++) {
        uint8_t c = col + (7 * i);
        if (c < MELT_WIDTH)
            melt_pour_bitmap(mode, str, c, &font[out[i] * 6], 1, 6);
        else
            break;
    }
}

uint8_t screen[MELT_HEIGHT / CHAR_BIT][MELT_WIDTH] = {0};
uint8_t font[FONT_SYMBOLS] = {
    0x00, 0x00, 0x00, 0x00, 0x00, 0x00, 0x00, 0x38, 0x55, 0x54, 0x55, 0x08, 0x00, 0x3E, 0x6B, 0x6F, 0x6B, 0x3E, 0x00,
    0x1C, 0x3E, 0x7C, 0x3E, 0x1C, 0x00, 0x18, 0x3C, 0x7E, 0x3C, 0x18, 0x00, 0x30, 0x36, 0x7F, 0x36, 0x30, 0x00, 0x18,
    0x5C, 0x7E, 0x5C, 0x18, 0x00, 0x00, 0x18, 0x18, 0x00, 0x00, 0xFF, 0xFF, 0xE7, 0xE7, 0xFF, 0xFF, 0x00, 0x3C, 0x24,
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    0x44, 0x54, 0x54, 0x38, 0x00, 0x7C, 0x10, 0x38, 0x44, 0x38, 0x00, 0x48, 0x34, 0x14, 0x14, 0x7C};
